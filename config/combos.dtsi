#include "hammer40_keylabels.h"

/*
  ╭─────────────────────────╮   ╭─────────────────────────╮
  │ LT5 LT4 LT3 LT2 LT1 LT0 │   │ RT0 RT1 RT2 RT3 RT4 RT5 │
  │ LM5 LM4 LM3 LM2 LM1 LM0 │___│ RM0 RM1 RM2 RM3 RM4 RM5 │
  │ LB5 LB4 LB3 LB2 LB1 LB0  MD0  RB0 RB1 RB2 RB3 RB4 RB5 │
  │ LH5 LH4 LH3 LH2 LH1 LH0  MD1  RH0 RH1 RH3 RH3 RH4 RH5 │
  ╰───────────────────────────────────────────────────────╯    
*/

// left and right bracket [ ]
ZMK_COMBO(lbkt, &kp LBKT, RT1 RT2, DEF, COMBO_TERM_FAST)
ZMK_COMBO(rbkt, &kp RBKT, RT2 RT3, DEF, COMBO_TERM_FAST)

// left and right parenthesis ( )
ZMK_COMBO(lpar, &kp LPAR, RM1 RM2, DEF NUM, COMBO_TERM_FAST)
ZMK_COMBO(rpar, &kp RPAR, RM2 RM3, DEF NUM, COMBO_TERM_FAST)

// apostrophe
ZMK_COMBO(apos, &kp APOS, RM3 RM4, DEF NUM, COMBO_TERM_FAST)

// left and right less-then and greater-then < >
ZMK_COMBO(lt, &kp LT, LT3 LT2, DEF, COMBO_TERM_FAST)
ZMK_COMBO(gt, &kp GT, LT2 LT1, DEF, COMBO_TERM_FAST)

// minus and equal - =
ZMK_COMBO(minus, &kp MINUS, RB1 RB2, DEF NUM, COMBO_TERM_FAST)
ZMK_COMBO(equal, &kp EQUAL, RB2 RB3, DEF NUM, COMBO_TERM_FAST)