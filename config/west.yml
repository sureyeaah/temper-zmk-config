## config/west.yml
```yaml
manifest:
  remotes:
    - name: zmkfirmware
      url-base: https://github.com/zmkfirmware
    - name: urob
      url-base: https://github.com/urob
    - name: petejohanson
      url-base: https://github.com/petejohanson
    - name: caksoylar
      url-base: https://github.com/caksoylar
    - name: keeb-it
      url-base: https://github.com/keeb-it
  projects:
    - name: zmk
      remote: zmkfirmware
      revision: main
      import: app/west.yml
    # Note: The following imports only shields definition files
    - name: zmk-keyboards
      remote: keeb-it
      revision: main
    - name: zmk-rgbled-widget
      remote: caksoylar
      revision: main
    - name: zmk-helpers
      remote: urob
      revision: main
      path: modules/helpers
    - name: zmk-auto-layer
      remote: urob
      revision: main
      path: modules/auto-layer
    - name: zmk-tri-state
      remote: urob
      revision: main
      path: modules/tri-state
  self:
    path: config
```
